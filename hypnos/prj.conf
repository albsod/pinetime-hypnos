## CMakeLists.txt
```
# SPDX-License-Identifier: Apache-2.0

cmake_minimum_required(VERSION 3.13.1)

# Add the pinetime board
list(APPEND BOARD_ROOT ${CMAKE_CURRENT_LIST_DIR}/..)
list(APPEND DTS_ROOT ${CMAKE_CURRENT_LIST_DIR}/..)

# Config files
IF("$ENV{LOGGING}" STREQUAL "off")
  message(STATUS "LOGGING will be disabled.")
  set(CONF_FILE ${CMAKE_CURRENT_LIST_DIR}/prj.conf)
ELSE()
  message(STATUS "LOGGING will be enabled.")
  set(CONF_FILE ${CMAKE_CURRENT_LIST_DIR}/prj.conf ${CMAKE_CURRENT_LIST_DIR}/logging.conf)
ENDIF()

include($ENV{ZEPHYR_BASE}/cmake/app/boilerplate.cmake NO_POLICY_SCOPE)
include_directories(include)
project(hypnos)

FILE(GLOB app_sources src/*.c)
target_sources(app PRIVATE ${app_sources})

# Get current time
execute_process(
  COMMAND date --iso-8601=seconds # e.g. 2020-04-04T14:17:34+02:00
  OUTPUT_VARIABLE CURRENT_TIME
  OUTPUT_STRIP_TRAILING_WHITESPACE
)

set(CMAKE_C_FLAGS "${CMAKE_C_FLAGS} -DCURRENT_TIME_OF_BUILD=\"${CURRENT_TIME}\"")
set(CMAKE_C_FLAGS "${CMAKE_C_FLAGS} -include clock.h")
```

## prj.conf
```kconfig
# SPDX-License-Identifier: Apache-2.0

# Battery status
CONFIG_ADC=y
CONFIG_ADC_ASYNC=y

# GPIO
CONFIG_GPIO=y

# Time functions
CONFIG_NEWLIB_LIBC=y

# Display
CONFIG_SPI=y
CONFIG_DISPLAY=y
CONFIG_ST7789V=y
CONFIG_ST7789V_RGB565=y

# Graphics
CONFIG_LVGL=y
CONFIG_LVGL_OBJ_LABEL=y
CONFIG_LVGL_COLOR_DEPTH_16=y
CONFIG_LVGL_COLOR_16_SWAP=y
CONFIG_LVGL_BITS_PER_PIXEL=24
CONFIG_LVGL_HOR_RES=240
CONFIG_LVGL_VER_RES=240
CONFIG_LVGL_DISPLAY_DEV_NAME="DISPLAY"
CONFIG_LVGL_BUILD_IN_FONT_ROBOTO_22=y
CONFIG_LVGL_DEFAULT_FONT_BUILD_IN_ROBOTO_22=y
CONFIG_LVGL_TXT_ENC_UTF8=y

# Touch screen
CONFIG_SENSOR=y
CONFIG_CST816S=y
CONFIG_CST816S_NAME="CST816S"
CONFIG_CST816S_TRIGGER_GLOBAL_THREAD=y

# Bluetooth
CONFIG_BT=y
CONFIG_BT_PERIPHERAL=y
CONFIG_BT_GATT_DIS=y
CONFIG_BT_ATT_PREPARE_COUNT=5
CONFIG_BT_DEVICE_NAME="PineTime Hypnos"
CONFIG_BT_DEVICE_APPEARANCE=833
CONFIG_BT_DEVICE_NAME_DYNAMIC=y
CONFIG_BT_DEVICE_NAME_MAX=65
CONFIG_BT_GATT_CLIENT=y
CONFIG_BT_ATT_ENFORCE_FLOW=n

# Power management
CONFIG_SYS_POWER_MANAGEMENT=y
CONFIG_DEVICE_POWER_MANAGEMENT=y

# Accelerometer
CONFIG_BMA421=y
#CONFIG_BMA421_TRIGGER_NONE=y
CONFIG_BMA421_TRIGGER_GLOBAL_THREAD=y
## CONFIG_BMA421_TRIGGER_OWN_THREAD is not set
CONFIG_BMA421_ACC_RANGE_2G=y
CONFIG_BMA421_ACC_ODR_50HZ=y
CONFIG_BMA421_ACC_BWP_NORM_AVG4=y
#CONFIG_BMA421_ACC_PERF_MODE=y

#To test
#CONFIG_SYS_POWER_DEEP_SLEEP_STATES=y
# Required to disable default behavior of deep sleep on timeout
#CONFIG_SYS_PM_STATE_LOCK=y

CONFIG_DEBUG=y
CONFIG_STACK_USAGE=y
CONFIG_ASSERT_VERBOSE=y
CONFIG_DEBUG_INFO=y
CONFIG_DEBUG_OPTIMIZATIONS=y
CONFIG_SOC_LOG_LEVEL_DBG=y
```

## logging.conf
```kconfig
# SPDX-License-Identifier: Apache-2.0

# Logging
CONFIG_LOG=y
CONFIG_USE_SEGGER_RTT=y
CONFIG_RTT_CONSOLE=y
CONFIG_CONSOLE=y
```

## src/main.c
```c
/*
 * PineTime Hypnos: Smartwatch firmware for the PineTime dev kit
 * Copyright (c) 2020 Endian Technologies AB
 *
 * This is free software with ABSOLUTELY NO WARRANTY.
 *
 * SPDX-License-Identifier: Apache-2.0
 */

#include <zephyr.h>
#include "accelerometer.h"
#include "backlight.h"
#include "battery.h"
#include "bt.h"
#include "clock.h"
#include "cts_sync.h"
#include "display.h"
#include "event_handler.h"
#include "gfx.h"
#include "log.h"

/* ******** Thread prototypes, constants and macros ******** */
void main_thread(void);
void bt_thread(void);

#define STACKSIZE 1024
#define PRIORITY 7

K_THREAD_DEFINE(bt_id, STACKSIZE, bt_thread, NULL, NULL, NULL,
                PRIORITY, 0, 0);
K_THREAD_DEFINE(main_id, STACKSIZE, main_thread, NULL, NULL, NULL,
                PRIORITY, 0, 0);

/* ******** Functions ******** */
void main(void)
{
	LOG_INF("Welcome to PineTime Hypnos!");
	LOG_INF("This is free software with ABSOLUTELY NO WARRANTY.");

	gfx_init();
	clock_init();
	battery_init();
	accelerometer_init();
	display_init();
	event_handler_init();
	gfx_update();
	backlight_init();
}

void main_thread(void)
{
	while (true) {
		bt_await_off();
		LOG_INF("Disabling BLE advertising...");
		bt_adv_stop();
		cts_sync_enable(false);
		k_cpu_idle();
	}
}

void bt_thread(void)
{
	while (true) {
		bt_await_on();
		LOG_INF("Enabling BLE advertising...");
		if (bt_is_initialized()) {
			bt_adv_start();
		} else {
			bt_init();
			cts_sync_init();
		}
		cts_sync_enable(true);
		k_cpu_idle();
	}
}
```

## include/accelerometer.h
```c
/*
 * SPDX-License-Identifier: Apache-2.0
 */

#ifndef ACCELEROMETER__H
#define ACCELEROMETER__H

void accelerometer_init();
void accelerometer_log_data();

#endif /* ACCELEROMETER__H */
```

## include/backlight.h
```c
/*
 * SPDX-License-Identifier: Apache-2.0
 */

#ifndef BACKLIGHT__H
#define BACKLIGHT__H

void backlight_init(void);
void backlight_enable(bool);
bool backlight_is_enabled(void);

#endif /* BACKLIGHT__H */
```

## include/battery.h
```c
/*
 * Copyright (c) 2020 Endian Technologies AB
 *
 * SPDX-License-Identifier: MPL-2.0
 */

#ifndef BATTERY__H
#define BATTERY__H

void battery_init();
void battery_update_percentage();
void battery_update_charging_status(bool);
bool battery_get_charging_status();
uint32_t battery_raw_to_mv(int16_t raw);
uint32_t battery_mv_to_ppt(uint32_t mv);
void battery_show_status();
void battery_gfx_init();

#endif /* BATTERY__H */
```

## include/bt.h
```c
#ifndef BT__H
#define BT__H

#include <stdbool.h>

void bt_init(void);
bool bt_is_initialized(void);
bool bt_mode(void);
void bt_ready(void);
void bt_adv_start(void);
void bt_adv_stop(void);
void bt_on(void);
void bt_off(void);
void bt_await_on(void);
void bt_await_off(void);

#endif /* BT__H */
```

## include/clock.h
```c
/*
 * Copyright (c) 2020 Endian Technologies AB
 *
 * SPDX-License-Identifier: Apache-2.0
 */

#ifndef CLOCK__H
#define CLOCK__H

#include <cts_sync.h>

/* Stringify build time included by cmake */
#define _xstr(s) _str(s)
#define _str(s) #s
#define TIME_OF_BUILD _xstr(CURRENT_TIME_OF_BUILD)

void clock_init(void);
void clock_increment_local_time(void);
void clock_sync_time(cts_datetime_t *cts);
void clock_show_time(void);

#endif /* CLOCK__H */
```

## include/cts_sync.h
```c
/*
 * Modifications: Copyright (c) 2020 Endian Technologies AB
 * Copyright (c) 2016 Intel Corporation
 *
 * SPDX-License-Identifier: Apache-2.0
 */

#ifndef CTS__H
#define CTS__H

#include <time.h>

void cts_sync_init(void);
void cts_sync_loop(void);
void cts_update_datetime(struct tm *);

typedef struct {
	uint16_t year;
	uint8_t month;
	uint8_t day;
	uint8_t hours;
	uint8_t minutes;
	uint8_t seconds;
	uint8_t day_of_week;
	uint8_t exact_time_256;
	uint8_t adjust_reason;
} cts_datetime_t;

#endif /* CTS__H */
```

## include/display.h
```c
/*
 * Copyright (c) 2020 Endian Technologies AB
 *
 * SPDX-License-Identifier: Apache-2.0
 */

#ifndef DISPLAY__H
#define DISPLAY__H

void display_init(void);
void display_sleep(void);
void display_wake_up(void);

#endif /* DISPLAY__H */
```

## include/event_handler.h
```c
/*
 * Copyright (c) 2020 Endian Technologies AB
 *
 * SPDX-License-Identifier: Apache-2.0
 */

#ifndef EVENT_HANDLER__H
#define EVENT_HANDLER__H

#include <drivers/gpio.h>
#include <drivers/sensor.h>

void event_handler_init(void);
void display_off_isr(struct k_timer *);
void bt_toggle_unlock_isr(struct k_timer *);
void battery_percentage_isr(struct k_timer *);
void battery_charging_isr(struct device*, struct gpio_callback *, uint32_t);
void button_pressed_isr(struct device *, struct gpio_callback *, uint32_t);
void touch_tap_isr(struct device *, struct sensor_trigger *);

#endif /* EVENT_HANDLER */
```

## include/gfx.h
```c
/*
 * Copyright (c) 2020 Endian Technologies AB
 *
 * SPDX-License-Identifier: Apache-2.0
 */

#ifndef GFX__H
#define GFX__H

enum bt_symbol {
	BT_CONNECTED,
	BT_ADVERTISING_ON,
	BT_ADVERTISING_OFF,
};

enum battery_symbol {
	BAT_CHARGE,
	BAT_FULL,
	BAT_3,
	BAT_2,
	BAT_1,
	BAT_EMPTY
};

void gfx_init(void);
void gfx_battery_set_label(enum battery_symbol);
void gfx_bt_set_label(enum bt_symbol);
void gfx_time_set_label(char *);
void gfx_date_set_label(char *);
void gfx_update(void);

#endif /* GFX__H */
```

## include/log.h
```c
/*
 * Copyright (c) 2020 Endian Technologies AB
 *
 * SPDX-License-Identifier: Apache-2.0
 */

#ifndef LOGGING__H
#define LOGGING__H

#include <logging/log.h>

LOG_MODULE_DECLARE(hypnos, LOG_LEVEL_INF);

#endif /* LOGGING__H */
```

## include/touch.h
```c
/*
 * Copyright (c) 2020 Endian Technologies AB
 *
 * SPDX-License-Identifier: MPL-2.0
 */

#ifndef TOUCH__H
#define TOUCH__H

void touch_sleep(void);
void touch_wake_up(void);

#endif /* TOUCH__H */
```

## src/accelerometer.c
```c
/*
 * SPDX-License-Identifier: Apache-2.0
 */

#include <zephyr.h>
#include <stdio.h>
#include <drivers/sensor.h>
#include "accelerometer.h"
#include "log.h"
#include "gfx.h"

/* ********** ********** DEFINES ********** ********** ********** */

/* ********** **********  ********** ********** ********** */

/* ********** ********** VARIABLES AND STRUCTS ********** ********** */
static struct device *accel_dev;

struct sensor_value accel_data[3];
struct sensor_value temperature;

struct sensor_trigger trig;
/* ********** ********** ********** ********** ********** ********** */

/* ********** ********** FUNCTIONS ********** ********** */

static void trigger_handler(struct device *accel_dev, struct sensor_trigger *trigger)
{
	LOG_DBG("Accel:trigger_handler type %d", trigger->type);

	if (trigger->type != SENSOR_TRIG_DATA_READY) {
		LOG_ERR("trigger handler: unknown trigger type (%d).", trigger->type);
		return;
	}

	if (sensor_sample_fetch(accel_dev) < 0) {
		LOG_ERR("Accel sample update error.");
	}

	sensor_channel_get(accel_dev, SENSOR_CHAN_ACCEL_XYZ, accel_data);
}

void accelerometer_init()
{
	accel_dev = device_get_binding("bma421");
	if (!accel_dev) {
		LOG_ERR("Could not get BMA421 binding");
	}

	trig.chan = SENSOR_CHAN_ACCEL_XYZ; /* does not matter */
	trig.type = SENSOR_TRIG_DATA_READY;
	if (sensor_trigger_set(accel_dev, &trig, trigger_handler)) {
		LOG_ERR("Trigger set Error");
	}

	LOG_DBG("Accelerometer init: Done");
}

void accelerometer_log_data()
{
	if (sensor_sample_fetch(accel_dev)) {
		LOG_ERR("sensor_sample_fetch failed\n");
	} else {
		// sensor_channel_get(accel_dev, SENSOR_CHAN_ACCEL_XYZ, accel_data);
		LOG_INF("sensor_channel_get accel.X %d.%d", accel_data[0].val1, accel_data[0].val2);
		LOG_INF("sensor_channel_get accel.Y %d.%d", accel_data[1].val1, accel_data[1].val2);
		LOG_INF("sensor_channel_get accel.Z %d.%d", accel_data[2].val1, accel_data[2].val2);

		sensor_channel_get(accel_dev, SENSOR_CHAN_DIE_TEMP, &temperature);
		LOG_INF("sensor_channel_get temperature %d", temperature.val1);
	}
}
/* ********** ********** ********** ********** ********** */
```
