## CMakeLists.txt
```
# SPDX-License-Identifier: Apache-2.0

cmake_minimum_required(VERSION 3.13.1)

# Add the board
list(APPEND BOARD_ROOT ${CMAKE_CURRENT_LIST_DIR}/..)
list(APPEND DTS_ROOT ${CMAKE_CURRENT_LIST_DIR}/..)

# Enable configurations through environment variables
set(CONF_FILE ${CMAKE_CURRENT_LIST_DIR}/config/prj.conf ${CMAKE_CURRENT_LIST_DIR}/config/bootloader.conf)
IF("$ENV{BOOTLOADER}" STREQUAL n)
  set(CONF_FILE ${CMAKE_CURRENT_LIST_DIR}/config/prj.conf)
ENDIF()
IF("$ENV{LOGGING}" STREQUAL y)
  set(CONF_FILE ${CONF_FILE} ${CMAKE_CURRENT_LIST_DIR}/config/logging_rtt.conf)
ENDIF()

find_package(Zephyr REQUIRED HINTS $ENV{ZEPHYR_BASE})
include_directories(include)
project(hypnos)

FILE(GLOB app_sources src/*.c)
target_sources(app PRIVATE ${app_sources})

# Get current time
string(TIMESTAMP CURRENT_TIME %Y-%m-%dT%H:%M:%S)

# Get short commit hash
execute_process(
  COMMAND ${GIT_EXECUTABLE} describe --tags --dirty
  WORKING_DIRECTORY ${CMAKE_CURRENT_LIST_DIR}
  OUTPUT_VARIABLE FW_BUILD_GIT
  OUTPUT_STRIP_TRAILING_WHITESPACE
)
set(CMAKE_C_FLAGS "${CMAKE_C_FLAGS} -DCURRENT_TIME_OF_BUILD=\"${CURRENT_TIME}\" -DFW_BUILD=\"${FW_BUILD_GIT}\"")
```

## prj.conf
```kconfig
# SPDX-License-Identifier: Apache-2.0

# Battery status
CONFIG_ADC=y
CONFIG_ADC_ASYNC=y

# GPIO
CONFIG_GPIO=y

# Time functions
CONFIG_NEWLIB_LIBC=y

# Display
CONFIG_SPI=y
CONFIG_DISPLAY=y
CONFIG_ST7789V=y
CONFIG_ST7789V_RGB565=y

# Graphics
CONFIG_LVGL=y
CONFIG_LVGL_OBJ_LABEL=y
CONFIG_LVGL_COLOR_DEPTH_16=y
CONFIG_LVGL_COLOR_16_SWAP=y
CONFIG_LVGL_BITS_PER_PIXEL=24
CONFIG_LVGL_HOR_RES=240
CONFIG_LVGL_VER_RES=240
CONFIG_LVGL_DISPLAY_DEV_NAME="DISPLAY"
CONFIG_LVGL_BUILD_IN_FONT_ROBOTO_22=y
CONFIG_LVGL_DEFAULT_FONT_BUILD_IN_ROBOTO_22=y
CONFIG_LVGL_TXT_ENC_UTF8=y

# Touch screen
CONFIG_SENSOR=y
CONFIG_CST816S=y
CONFIG_CST816S_TRIGGER_GLOBAL_THREAD=y

# Heart rate Sensor
CONFIG_HRS3300=y

# Bluetooth
CONFIG_BT=y
CONFIG_BT_PERIPHERAL=y
CONFIG_BT_GATT_DIS=y
CONFIG_BT_ATT_PREPARE_COUNT=5
CONFIG_BT_DEVICE_NAME="PineTime Hypnos"
CONFIG_BT_DEVICE_APPEARANCE=833
CONFIG_BT_DEVICE_NAME_DYNAMIC=y
CONFIG_BT_DEVICE_NAME_MAX=65
CONFIG_BT_GATT_CLIENT=y
CONFIG_BT_ATT_ENFORCE_FLOW=n

# Power management
CONFIG_DEVICE_POWER_MANAGEMENT=y
```

## src/main.c
```c
/*
 * Hypnos: Smartwatch firmware for the PineTime
 * Copyright (c) 2020 Endian Technologies AB
 *
 * This is free software with ABSOLUTELY NO WARRANTY.
 *
 * SPDX-License-Identifier: Apache-2.0
 */

#include <zephyr.h>
#include "backlight.h"
#include "battery.h"
#include "bt.h"
#include "clock.h"
#include "cts_sync.h"
#include "display.h"
#include "event_handler.h"
#include "gfx.h"
#include "log.h"
#ifdef CONFIG_BOOTLOADER_MCUBOOT
#include "dfu/mcuboot.h"
#endif
#ifdef CONFIG_MCUMGR_CMD_FS_MGMT
#include <device.h>
#include <fs/fs.h>
#include "fs_mgmt/fs_mgmt.h"
#include <fs/littlefs.h>
#endif
#ifdef CONFIG_MCUMGR_CMD_OS_MGMT
#include "os_mgmt/os_mgmt.h"
#endif
#ifdef CONFIG_MCUMGR_CMD_IMG_MGMT
#include "img_mgmt/img_mgmt.h"
#endif

#ifdef CONFIG_MCUMGR_CMD_FS_MGMT
FS_LITTLEFS_DECLARE_DEFAULT_CONFIG(cstorage);
static struct fs_mount_t littlefs_mnt = {
	.type = FS_LITTLEFS,
	.fs_data = &cstorage,
	.storage_dev = (void *)FLASH_AREA_ID(storage),
	.mnt_point = "/lfs"
};
#endif

/* ******** Functions ******** */
void main(void)
{
	LOG_INF("Welcome to Hypnos!");
	LOG_INF("This is free software with ABSOLUTELY NO WARRANTY.");

	gfx_init();
	clock_init();
	battery_init();
	display_init();
	event_handler_init();
	gfx_update();
	backlight_init();

	/* Register the built-in mcumgr command handlers. */
#ifdef CONFIG_MCUMGR_CMD_FS_MGMT
	int rc = fs_mount(&littlefs_mnt);
	if (rc < 0) {
		LOG_ERR("Error mounting littlefs [%d]", rc);
	}

	fs_mgmt_register_group();
#endif
#ifdef CONFIG_MCUMGR_CMD_OS_MGMT
	os_mgmt_register_group();
#endif
#ifdef CONFIG_MCUMGR_CMD_IMG_MGMT
	img_mgmt_register_group();
#endif
	bt_init();

	while (true) {
		k_cpu_idle();
#ifdef CONFIG_LOG
		k_msleep(1); /* Allows messages to show up in the console */
#endif
	}
}
```

## include/bt.h
```c
#ifndef BT__H
#define BT__H

#include <stdbool.h>

void bt_init(void);
bool bt_is_initialized(void);
bool bt_mode(void);
void bt_ready(void);
void bt_adv_start(void);
void bt_adv_stop(void);
void bt_on(void);
void bt_off(void);
void bt_toggle_unlock(void);
bool bt_toggle_is_locked(void);
void bt_await_on(void);
void bt_await_off(void);

#endif /* BT__H */
```

## include/common.h
```c
/*
 * Copyright (c) 2020 Prevas A/S
 *
 * SPDX-License-Identifier: Apache-2.0
 */

void start_smp_bluetooth(void);
/* void start_smp_udp(void); */
```

## include/event_handler.h
```c
/*
 * Copyright (c) 2020 Endian Technologies AB
 *
 * SPDX-License-Identifier: Apache-2.0
 */

#ifndef EVENT_HANDLER__H
#define EVENT_HANDLER__H

#include <drivers/gpio.h>
#include <drivers/sensor.h>

void event_handler_init(void);
void display_off_isr(struct k_timer *);
#ifdef CONFIG_BOOTLOADER_MCUBOOT
void watchdog_refresh_isr(struct k_timer *);
#endif
void battery_percentage_isr(struct k_timer *);
void battery_charging_isr(const struct device*, struct gpio_callback *, uint32_t);
void button_pressed_isr(const struct device *, struct gpio_callback *, uint32_t);
void touch_tap_isr(const struct device *, struct sensor_trigger *);

#endif /* EVENT_HANDLER */
```

## include/gfx.h
```c
/*
 * Copyright (c) 2020 Endian Technologies AB
 *
 * SPDX-License-Identifier: Apache-2.0
 */

#ifndef GFX__H
#define GFX__H

enum bt_symbol {
	BT_CONNECTED,
	BT_ADVERTISING_ON,
	BT_ADVERTISING_OFF,
};

enum battery_symbol {
	BAT_CHARGE,
	BAT_FULL,
	BAT_3,
	BAT_2,
	BAT_1,
	BAT_EMPTY
};

void gfx_init(void);
void gfx_battery_set_label(enum battery_symbol);
void gfx_bt_set_label(enum bt_symbol);
void gfx_time_set_label(char *);
void gfx_date_set_label(char *);
void gfx_update(void);
void gfx_show_info(void);
void gfx_show_analog_watch(void);
void gfx_update_analog_watch(void);
void gfx_show_digital_watch(void);
void gfx_analog_watch_set_hands(int, int, int);

#endif /* GFX__H */
```

## include/gui.h
```c
/*
 * Copyright (c) 2020 Endian Technologies AB
 *
 * SPDX-License-Identifier: Apache-2.0
 */

#ifndef GUI__H
#define GUI__H

#include <drivers/sensor.h>

enum screen {
	DIGITAL_WATCH,
	ANALOG_WATCH,
	INFO
};

void gui_handle_touch_event(const struct device *, enum cst816s_gesture);
int gui_handle_button_event(void);
void gui_update_clock_and_battery(void);
void gui_handle_cts_sync_event(void);

#endif /* GUI__H */
```

## include/version.h
```c
/*
 * Copyright (c) 2020 Endian Technologies AB
 *
 * SPDX-License-Identifier: Apache-2.0
 */

#ifndef VERSION__H
#define VERSION__H

/* Stringify firmware build data included by cmake */
#define _xstr(s) _str(s)
#define _str(s) #s
#define TIME_OF_BUILD _xstr(CURRENT_TIME_OF_BUILD)
#define FW_BUILD _xstr(GIT_HASH)

#endif /* VERSION__H */
```

## src/accelerometer.c
```c
/*
 * Copyright (c) 2020 Stephane Dorre <stephane.dorre@gmail.com>
 *
 * SPDX-License-Identifier: Apache-2.0
 */

#include <zephyr.h>
#include <stdio.h>
#include <drivers/sensor.h>
#include "accelerometer.h"
#include "log.h"
#include "gfx.h"

/* ********** ********** DEFINES ********** ********** ********** */

/* ********** **********  ********** ********** ********** */

/* ********** ********** VARIABLES AND STRUCTS ********** ********** */
static struct device *accel_dev;

struct sensor_value accel_data[3];
struct sensor_value temperature;

struct sensor_trigger trig;
/* ********** ********** ********** ********** ********** ********** */

/* ********** ********** FUNCTIONS ********** ********** */

static void trigger_handler(struct device *accel_dev, struct sensor_trigger *trigger)
{
	LOG_DBG("Accel:trigger_handler type %d", trigger->type);

	if (trigger->type != SENSOR_TRIG_DATA_READY) {
		LOG_ERR("trigger handler: unknown trigger type (%d).", trigger->type);
		return;
	}

	if (sensor_sample_fetch(accel_dev) < 0) {
		LOG_ERR("Accel sample update error.");
	}

	sensor_channel_get(accel_dev, SENSOR_CHAN_ACCEL_XYZ, accel_data);
}

void accelerometer_init()
{
	accel_dev = device_get_binding("bma421");
	if (!accel_dev) {
		LOG_ERR("Could not get BMA421 binding");
	}

	trig.chan = SENSOR_CHAN_ACCEL_XYZ; /* does not matter */
	trig.type = SENSOR_TRIG_DATA_READY;
	if (sensor_trigger_set(accel_dev, &trig, trigger_handler)) {
		LOG_ERR("Trigger set Error");
	}

	LOG_DBG("Accelerometer init: Done");
}

void accelerometer_log_data()
{
	if (sensor_sample_fetch(accel_dev)) {
		LOG_ERR("sensor_sample_fetch failed\n");
	} else {
		// sensor_channel_get(accel_dev, SENSOR_CHAN_ACCEL_XYZ, accel_data);
		LOG_INF("sensor_channel_get accel.X %d.%d", accel_data[0].val1, accel_data[0].val2);
		LOG_INF("sensor_channel_get accel.Y %d.%d", accel_data[1].val1, accel_data[1].val2);
		LOG_INF("sensor_channel_get accel.Z %d.%d", accel_data[2].val1, accel_data[2].val2);

		sensor_channel_get(accel_dev, SENSOR_CHAN_DIE_TEMP, &temperature);
		LOG_INF("sensor_channel_get temperature %d", temperature.val1);
	}
}
/* ********** ********** ********** ********** ********** */
```

## src/backlight.c
```c
/*
 * SPDX-License-Identifier: Apache-2.0
 */

#include <zephyr.h>
#include <stdbool.h>
#include <drivers/gpio.h>
#include <display.h>
#include "backlight.h"
#include "log.h"

/* ********** ********** DEFINES ********** ********** ********** */
#define BACKLIGHT_PORT  DT_GPIO_LABEL(DT_ALIAS(led1), gpios)
#define BACKLIGHT_1     DT_GPIO_PIN(DT_ALIAS(led0), gpios)
#define BACKLIGHT_2     DT_GPIO_PIN(DT_ALIAS(led1), gpios)
#define BACKLIGHT_3     DT_GPIO_PIN(DT_ALIAS(led2), gpios)
/* ********** **********  ********** ********** ********** */

/* ********** ********** VARIABLES AND STRUCTS ********** ********** */
static const struct device* backlight_dev;
static bool backlight_enabled = false;
/* ********** ********** ********** ********** ********** ********** */

/* ********** ********** FUNCTIONS ********** ********** */
void backlight_init()
{
	backlight_dev = device_get_binding(BACKLIGHT_PORT);
	gpio_pin_configure(backlight_dev, BACKLIGHT_1, GPIO_OUTPUT);
	gpio_pin_configure(backlight_dev, BACKLIGHT_2, GPIO_OUTPUT);
	gpio_pin_configure(backlight_dev, BACKLIGHT_3, GPIO_OUTPUT);
	backlight_enable(true);
	LOG_DBG("Backlight init: Done");
}

void backlight_enable(bool enable)
{
	gpio_pin_set_raw(backlight_dev, BACKLIGHT_1, enable ? 0 : 1);
	gpio_pin_set_raw(backlight_dev, BACKLIGHT_2, enable ? 0 : 1);
	gpio_pin_set_raw(backlight_dev, BACKLIGHT_3, enable ? 0 : 1);
	backlight_enabled = enable;
}

bool backlight_is_enabled()
{
	return backlight_enabled;
}
/* ********** ********** ********** ********** ********** */
```

## src/battery.c
```c
/*
 * Copyright (c) 2020 Endian Technologies AB
 *
 * SPDX-License-Identifier: Apache-2.0
 *
 * battery_mv_to_ppt, battery_level_point, battery_raw_to_mv:
 * Copyright (c) 2020 Nordic Semiconductor
 */

#include <zephyr.h>
#include <stdint.h>
#include <drivers/gpio.h>
#include <drivers/adc.h>
#include <syscalls/adc.h>
#include <stdbool.h>
#include "battery.h"
#include "gfx.h"
#include "log.h"

#define CHANNEL_ID 7
#define RESOLUTION 12
#define DIVIDER 2
#define COUNT_DOWN 5000

/* ********** ********** VARIABLES ********** ********** */
static const struct device* percentage_dev;
static int16_t data[1];
static uint32_t percentage;
static bool charging;
/* ********** ********** ********** ********** ********** */

/* ********** ********** STRUCTS ********** **********  */
struct battery_level_point {
	/** Remaining life at #lvl_mV. */
	uint16_t lvl_pptt;

	/** Battery voltage at #lvl_pptt remaining life. */
	uint16_t lvl_mV;
};

static const struct battery_level_point lipo[] = {
	{ 10000, 4200 },
	{ 5000, 3660},
	{ 2100, 3600 },
	{ 1000, 3560},
	{ 0, 3100 },
};

static const struct adc_sequence sequence = {
	.channels    = BIT(CHANNEL_ID),
	.buffer      = data,
	.buffer_size = sizeof(data),
	.resolution  = RESOLUTION,
};

static const struct adc_channel_cfg m_1st_channel_cfg = {
	.gain             = ADC_GAIN_1_4,
	.reference        = ADC_REF_INTERNAL,
	.acquisition_time = ADC_ACQ_TIME(ADC_ACQ_TIME_MICROSECONDS, 20),
	.channel_id       = CHANNEL_ID,
#if defined(CONFIG_ADC_CONFIGURABLE_INPUTS)
	.input_positive   = 8,
#endif
};

/* ********** ********** ********** ********** ********** */

/* ********** ********** FUNCTIONS ********** ********** */
void battery_init()
{
	percentage_dev = device_get_binding("ADC_0");
	if (percentage_dev == NULL) {
		LOG_ERR("Failed to get binding for ADC_0 device!");
	}

	if (adc_channel_setup(percentage_dev, &m_1st_channel_cfg) < 0) {
		LOG_ERR("Failed to setup channel for adc!");
	}

	LOG_DBG("Battery status init: Done");
}

void battery_update_percentage()
{
	adc_read(percentage_dev, &sequence);
	uint32_t mv = battery_raw_to_mv(data[0]);
	percentage = battery_mv_to_ppt(mv)/100;
}

void battery_update_charging_status(bool value)
{
	charging = value;
}

bool battery_get_charging_status()
{
	return charging;
}

uint32_t battery_raw_to_mv(int16_t raw)
{
	return (DIVIDER*600*(((uint32_t)raw*4*1000) >> RESOLUTION))/1000;
}

uint32_t battery_mv_to_ppt(uint32_t mv)
{
	const struct battery_level_point *pb = lipo;

	if (mv >= pb->lvl_mV) {
		return pb->lvl_pptt;
	}

	while ((pb->lvl_pptt > 0)
	       && (mv < pb->lvl_mV)) {
		++pb;
	}
	if (mv < pb->lvl_mV) {

		return pb->lvl_pptt;
	}

	const struct battery_level_point *pa = pb - 1;

	return pb->lvl_pptt
	       + ((pa->lvl_pptt - pb->lvl_pptt)
		  * (mv - pb->lvl_mV)
		  / (pa->lvl_mV - pb->lvl_mV));
}

void battery_show_status()
{
	battery_update_percentage();
	if (charging) {
		LOG_INF("Battery status: %u%% (charging)",
			percentage);
		gfx_battery_set_label(BAT_CHARGE);
	} else {
		LOG_INF("Battery status: %u%% (discharging)",
			percentage);

		if (percentage > 89) {
			gfx_battery_set_label(BAT_FULL);
		} else if (percentage > 74) {
			gfx_battery_set_label(BAT_3);
		} else if (percentage > 49) {
			gfx_battery_set_label(BAT_2);
		} else if (percentage > 24) {
			gfx_battery_set_label(BAT_1);
		} else {
			gfx_battery_set_label(BAT_EMPTY);
		}
	}
}

/* ********** ********** ********** ********** ********** */
```

## src/bt.c
```c
/*
 * Copyright (c) 2012-2014 Wind River Systems, Inc.
 * Copyright (c) 2015-2016 Intel Corporation
 * Copyright (c) 2020 Endian Technologies AB
 * Copyright (c) 2020 max00
 * Copyright (c) 2020 Prevas A/S
 *
 * SPDX-License-Identifier: Apache-2.0
 */

#include <zephyr/types.h>
#include <stddef.h>
#include <stdbool.h>
#include <string.h>
#include <sys/byteorder.h>
#include <zephyr.h>

#include <settings/settings.h>

#include <bluetooth/bluetooth.h>
#include <bluetooth/hci.h>
#include <bluetooth/conn.h>
#include <bluetooth/uuid.h>
#include <bluetooth/gatt.h>

#ifdef CONFIG_MCUMGR
#include <mgmt/mcumgr/smp_bt.h>
#endif

#include "cts_sync.h"
#include "gfx.h"
#include "log.h"
#include "version.h"

/* ********** Function prototypes ********** */
static void connected(struct bt_conn *conn, uint8_t err);
static void disconnected(struct bt_conn *conn, uint8_t reason);
static bool le_param_req(struct bt_conn *conn, struct bt_le_conn_param *param);
static void le_param_updated(struct bt_conn *conn, uint16_t interval, uint16_t latency, uint16_t timeout);

/* ********** Variables ********** */

static struct k_work advertise_work;

static const struct bt_data ad[] = {
	BT_DATA_BYTES(BT_DATA_FLAGS, (BT_LE_AD_GENERAL | BT_LE_AD_NO_BREDR)),
	/* Device information */
	BT_DATA_BYTES(BT_DATA_UUID16_ALL,
		      0x0a, 0x18),
	/* Current time */
	BT_DATA_BYTES(BT_DATA_UUID16_ALL,
		      0x05, 0x18),
#ifdef CONFIG_MCUMGR
	/* SMP */
	BT_DATA_BYTES(BT_DATA_UUID128_ALL,
		      0x84, 0xaa, 0x60, 0x74, 0x52, 0x8a, 0x8b, 0x86,
		      0xd3, 0x4c, 0xb7, 0x1d, 0x1d, 0xdc, 0x53, 0x8d),
#endif
};

static struct bt_conn_cb m_conn_callbacks = {
	.connected = connected,
	.disconnected = disconnected,
	.le_param_req = le_param_req,
	.le_param_updated = le_param_updated
};

static struct bt_le_adv_param param = BT_LE_ADV_PARAM_INIT(
	BT_LE_ADV_OPT_CONNECTABLE | BT_LE_ADV_OPT_USE_NAME,
	BT_GAP_ADV_SLOW_INT_MIN,
	BT_GAP_ADV_SLOW_INT_MAX,
	NULL
);

/* ********** Functions ********** */
static int settings_runtime_load(void)
{
#if defined(CONFIG_BOARD_PINETIME)
	settings_runtime_set("bt/dis/model",
			     "PineTime",
			     sizeof("PineTime"));
	settings_runtime_set("bt/dis/manuf",
			     "PINE64",
			     sizeof("PINE64"));
	settings_runtime_set("bt/dis/hw",
			     "1.0a",
			     sizeof("1.0a"));
#endif
#if defined(CONFIG_BOARD_P8)
	settings_runtime_set("bt/dis/model",
			     "P8",
			     sizeof("P8"));
	settings_runtime_set("bt/dis/manuf",
			     "Colmi",
			     sizeof("Colmi"));
#endif
	settings_runtime_set("bt/dis/sw",
			     CONFIG_BT_DEVICE_NAME,
			     sizeof(CONFIG_BT_DEVICE_NAME));
	settings_runtime_set("bt/dis/fw",
			     FW_VERSION,
			     sizeof(FW_VERSION));
	return 0;
}

static void advertise(struct k_work *work)
{
	int rc;

	bt_le_adv_stop();

	rc = bt_le_adv_start(&param, ad, ARRAY_SIZE(ad), NULL, 0);
	if (rc) {
		LOG_ERR("Advertising failed to start (rc %d)", rc);
		return;
	}

	LOG_INF("Advertising successfully started");
}

static void connected(struct bt_conn *conn, uint8_t err)
{
	if (err) {
		return;
	}
	LOG_INF("connected");
	cts_sync_enable(true);
	gfx_bt_set_label(BT_CONNECTED);
	gfx_update();
}

static void disconnected(struct bt_conn *conn, uint8_t reason)
{
	LOG_INF("disconnected (reason: %u)", reason);
	cts_sync_enable(false);
	gfx_bt_set_label(BT_ADVERTISING_ON);
	gfx_update();
}

static bool le_param_req(struct bt_conn *conn, struct bt_le_conn_param *param)
{
	return true;
}

static void le_param_updated(struct bt_conn *conn, uint16_t interval, uint16_t latency, uint16_t timeout)
{

}

void bt_init(void)
{
	int err = bt_enable(NULL);
	if (err) {
		LOG_ERR("Bluetooth init failed (err %d)", err);
		return;
	}

	settings_load();
	settings_runtime_load();

	k_work_init(&advertise_work, advertise);
	bt_conn_cb_register(&m_conn_callbacks);

	k_work_submit(&advertise_work);
#ifdef CONFIG_MCUMGR
	/* Initialize the Bluetooth mcumgr transport. */
	smp_bt_register();
#endif
	cts_sync_init();

	LOG_DBG("Bluetooth initialized");
}

void bt_adv_stop(void)
{
	k_sleep(K_MSEC(400));

	int err = bt_le_adv_stop();
	if (err) {
		LOG_ERR("Advertising failed to stop (err %d)", err);
		return;
	}
}
```

## src/clock.c
```c
/*
 * Copyright (c) 2020 Endian Technologies AB
 *
 * SPDX-License-Identifier: Apache-2.0
 */

#include <zephyr.h>
#include <time.h>
#include <stdio.h>
#include <stdlib.h>
#include "battery.h"
#include "bt.h"
#include "version.h"
#include "cts_sync.h"
#include "log.h"
#include "event_handler.h"
#include "gfx.h"

/* ********** ********** VARIABLES ********** ********** */
static char time_label_str[32];
static char date_label_str[32];
static uint64_t uptime_ms;
static uint64_t last_uptime_ms;
static uint64_t elapsed_ms;

static struct tm ti = {
	.tm_sec = 0,
	.tm_min = 0,
	.tm_hour = 0,
	.tm_mday = 0,
	.tm_mon = 0,
	.tm_year = 0,
	.tm_wday = 0,
};

/* ********** ********** FUNCTIONS *********** ********** */
void clock_str_to_local_time(const char *str)
{
	if (sscanf(str, "%d-%d-%dT%d:%d:%d", &ti.tm_year, &ti.tm_mon,
		   &ti.tm_mday, &ti.tm_hour, &ti.tm_min, &ti.tm_sec) != 6) {
		LOG_ERR("Failed to parse time of build.");
	}
	ti.tm_year-=1900;
	ti.tm_mon-=1;
	mktime(&ti);
}

void clock_init()
{
	/* Set time to time of build */
	clock_str_to_local_time(TIME_OF_BUILD);
	LOG_DBG("Time set to time of build");
	LOG_DBG("Clock init: Done");
}

void clock_update_elapsed_ms()
{
	uptime_ms = k_uptime_get();
	elapsed_ms = uptime_ms - last_uptime_ms;
	last_uptime_ms = uptime_ms;
}

/* Called by cts sync */
void clock_sync_time(cts_datetime_t *cts)
{
	ti.tm_year = cts->year -1900;
	ti.tm_mon = cts->month -1;
	ti.tm_mday = cts->day;
	ti.tm_hour = cts->hours;
	ti.tm_min = cts->minutes;
	ti.tm_sec = cts->seconds;
	mktime(&ti);
	clock_update_elapsed_ms();
}

/* Called by event handler */
void clock_increment_local_time()
{
	clock_update_elapsed_ms();
	ti.tm_sec += elapsed_ms / 1000;
	mktime(&ti);
}

void clock_show_time()
{
	strftime(time_label_str, 32, "%H:%M", &ti);
	strftime(date_label_str, 32, "%a %d %b", &ti);
	gfx_time_set_label(time_label_str);
	gfx_date_set_label(date_label_str);
	gfx_analog_watch_set_hands(ti.tm_hour, ti.tm_min, ti.tm_sec);
}
```

## src/cts_sync.c
```c
/*
 * Copyright (c) 2020 Dejvino
 * Copyright (c) 2020 Endian Technologies AB
 * Copyright (c) 2020 max00
 *
 * SPDX-License-Identifier: Apache-2.0
 */

#include <bluetooth/bluetooth.h>
#include <bluetooth/hci.h>
#include <bluetooth/conn.h>
#include <bluetooth/uuid.h>
#include <bluetooth/gatt.h>
#include <time.h>
#include "log.h"
#include "cts_sync.h"
#include "clock.h"
#include "gui.h"

/* ********** Definitions ********** */
#define CTS_SYNC_INTERVAL K_SECONDS(60)

/* ********** Function prototypes ********** */
static void cts_sync_timer_timeout_handler(struct k_timer *);
static void cts_sync_processor(struct bt_conn *, void *);

/* ********** Variables ********** */
static struct k_timer m_cts_sync_timer;
static struct bt_gatt_discover_params cts_discovery_params;
static struct bt_uuid_16 uuid = BT_UUID_INIT_16(0);
static struct bt_gatt_read_params read_params;
cts_datetime_t clock_datetime;
static struct {
	int offset;
	cts_datetime_t datetime;
} m_read_buf;

/* ********** Functions ********** */
void cts_sync_init()
{
	k_timer_init(&m_cts_sync_timer, cts_sync_timer_timeout_handler, NULL);
}

void cts_sync_enable(bool enable)
{
	if (enable) {
		k_timer_start(&m_cts_sync_timer, K_NO_WAIT, CTS_SYNC_INTERVAL);
	} else {
		k_timer_stop(&m_cts_sync_timer);
	}
}

static void sync_cts_to_clock(cts_datetime_t* cts_datetime)
{
	if (cts_datetime->year + cts_datetime->day + cts_datetime->hours
	    + cts_datetime->minutes + cts_datetime->seconds == 0) {
		LOG_WRN("Ignoring suspicious time data from companion application.");
		return;
	}

	LOG_INF("CTS sync to clock started.\n Y%04d D%03d T%2d:%2d:%2d",
		cts_datetime->year, cts_datetime->day,
		cts_datetime->hours, cts_datetime->minutes, cts_datetime->seconds);

	memcpy(&clock_datetime, cts_datetime, sizeof(clock_datetime));
	clock_sync_time(cts_datetime);
	LOG_INF("CTS sync to clock complete.");
	gui_handle_cts_sync_event();
}

void cts_update_datetime(struct tm *t)
{
	t->tm_year = clock_datetime.year -1900;
	t->tm_mon = clock_datetime.month -1;
	t->tm_mday = clock_datetime.day;
	t->tm_hour = clock_datetime.hours;
	t->tm_min = clock_datetime.minutes;
	t->tm_sec = clock_datetime.seconds;
}

static void cts_sync_timer_timeout_handler(struct k_timer *tmr)
{
	bt_conn_foreach(BT_CONN_TYPE_LE, cts_sync_processor, NULL);
}

uint8_t cts_sync_read(struct bt_conn *conn, uint8_t err,
				    struct bt_gatt_read_params *params,
				    const void *data, uint16_t length)
{
	LOG_DBG("Reading CCC data: err %d, %d bytes, offset %d.", err, length, m_read_buf.offset);

	if (!data || length <= 0) {
		sync_cts_to_clock(&m_read_buf.datetime);
		return BT_GATT_ITER_STOP;
	}

	memcpy(&m_read_buf.datetime + m_read_buf.offset, data, length);
	m_read_buf.offset += length;

	return BT_GATT_ITER_CONTINUE;
}

uint8_t cts_sync_service_discovered(struct bt_conn* conn, const struct bt_gatt_attr* attr,
        struct bt_gatt_discover_params* params)
{
	if (!attr) {
		LOG_INF("CTS Service Discovery completed");
		return BT_GATT_ITER_STOP;
	}
	LOG_DBG("Discovered attribute, handle: %u", attr->handle);

	memset(&read_params, 0, sizeof(read_params));
	read_params.func = cts_sync_read;
	read_params.by_uuid.uuid = (struct bt_uuid *) &uuid;
	read_params.by_uuid.start_handle = attr->handle;
	read_params.by_uuid.end_handle = 0xffff;
	m_read_buf.offset = 0;
	if (bt_gatt_read(conn, &read_params) < 0) {
		LOG_DBG("Could not initiate read of CCC data.");
	}

	return BT_GATT_ITER_STOP;
}

static void cts_sync_processor(struct bt_conn *conn, void *data)
{
	memcpy(&uuid, BT_UUID_CTS_CURRENT_TIME, sizeof(uuid));
	cts_discovery_params.func = cts_sync_service_discovered;
	cts_discovery_params.start_handle = 0x0001;
	cts_discovery_params.end_handle = 0xFFFF;
	cts_discovery_params.type = BT_GATT_DISCOVER_CHARACTERISTIC;
	cts_discovery_params.uuid = (struct bt_uuid *) &uuid;

	if (bt_gatt_discover(conn, &cts_discovery_params) != 0) {
		LOG_ERR("CTS Sync > GATT discovery FAILED.");
	}
}
```
