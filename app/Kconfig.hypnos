## app/Kconfig.hypnos
```kconfig
menu "Hypnos"

rsource "drivers/sensor/Kconfig"
rsource "subsys/Kconfig"

endmenu
```

## app/Kconfig.pinetime
```kconfig
menu "Pinetime"

config TEXT_SECTION_OFFSET
	hex
	prompt "TEXT section offset" if !BOOTLOADER_MCUBOOT
	default 0x20 if BOOTLOADER_MCUBOOT
	default 0
	help
	  If the application is built for chain-loading by a bootloader this
	  variable is required to be set to value that leaves sufficient
	  space between the beginning of the image and the start of the .text
	  section to store an image header or any other metadata.
	  In the particular case of the MCUboot bootloader this reserves enough
	  space to store the image header, which should also meet vector table
	  alignment requirements on most ARM targets, although some targets
	  may require smaller or larger values.

rsource "drivers/sensor/Kconfig"
rsource "subsys/Kconfig"

endmenu
```

## app/boards/arm/p8/Kconfig
```kconfig
# P8 smartwatch configuration

# Copyright (c) 2018 makerdiary.com.
# SPDX-License-Identifier: Apache-2.0

if BOARD_P8     

config BOARD_ENABLE_DCDC
	bool "Enable DCDC mode"
	select SOC_DCDC_NRF52X
	default y

endif # BOARD_P8
```

## app/boards/arm/p8/Kconfig.defconfig
```kconfig
# nRF52832-MDK board configuration

# Copyright (c) 2018 makerdiary.com.
# SPDX-License-Identifier: Apache-2.0

if BOARD_P8     

config BOARD
	default "p8"

if I2C

config I2C_1
	default y

endif # I2C

if SPI

config SPI_0
        default y

endif # SPI

config BT_CTLR
	default BT

endif # P8            
```

## app/boards/arm/pinetime/Kconfig.defconfig
```kconfig
# nRF52832-MDK board configuration

# Copyright (c) 2018 makerdiary.com.
# SPDX-License-Identifier: Apache-2.0

if BOARD_PINETIME     

config BOARD
	default "pinetime"

if I2C

config I2C_1
	default y

endif # I2C

config BT_CTLR
	default BT

endif # PINETIME            
```

## app/drivers/sensor/cst816s/Kconfig
```kconfig
# CST816S Hynitron touchscreen
# SPDX-License-Identifier: Apache-2.0
#
#menuconfig CST816S
#	bool "hynitron cst816 touchscreen "
#	depends on I2C
#	help
#	 Enable driver for hynitron touchscreen. 
menuconfig CST816S
        bool "CST816S Touchscreen"
        depends on I2C
        help
          Enable driver for hynitron touchscreen. 

if CST816S

choice
	prompt "Trigger mode"
	default CST816S_TRIGGER_NONE
	help
	  Specify the type of triggering used by the driver.

config CST816S_TRIGGER_NONE
	bool "No trigger"

config CST816S_TRIGGER_GLOBAL_THREAD
	bool "Use global thread"
	depends on GPIO
	select CST816S_TRIGGER

config CST816S_TRIGGER_OWN_THREAD
	bool "Use own thread"
	depends on GPIO
	select CST816S_TRIGGER

endchoice

config CST816S_TRIGGER
	bool

config CST816S_THREAD_PRIORITY
	int "Thread priority"
	depends on CST816S_TRIGGER_OWN_THREAD && CST816S_TRIGGER
	default 10
	help
	  Priority of thread used by the driver to handle interrupts.

config CST816S_THREAD_STACK_SIZE
	int "Thread stack size"
	depends on CST816S_TRIGGER_OWN_THREAD && CST816S_TRIGGER
	default 512
	help
	  Stack size of thread used by the driver to handle interrupts.

endif # CST816S
```

## app/west.yml
```yaml
# The west manifest file for Hypnos.
#
# The per-installation west configuration file specifies the location of this
# manifest file. The "path" option in the [manifest] section of .west/config
# defines the folder that contains west.yml. The path is relative to the folder
# that contains .west.
#
# You can create your own manifest files and put them in any
# repository you want, to create your own custom Pinetime installation.
# For example, you could create a manifest file in your own
# out-of-tree application directory, which would pull the pinetime repository
# in as an ordinary project.
#
# You can pass your manifest repositories to west init when creating a
# new pinetime installation. See the west documentation for more
# information.

manifest:
  defaults:
    remote: app

  remotes:
    - name: app
      url-base: https://github.com/zephyrproject-rtos

  # External projects
  #
  projects:
    - name: cmsis
      path: modules/hal/cmsis
      revision: b0612c97c1401feeb4160add6462c3627fe90fc7
    - name: hal_nordic
      path: modules/hal/nordic
      revision: a6e5299041f152da5ae0ab17b2e44e088bb96d6d
    - name: lvgl
      path: modules/lib/gui/lvgl
      revision: 783c1f78c8e39751fe89d0883c8bce7336f55e94
    - name: littlefs
      path: modules/fs/littlefs
      revision: 9e4498d1c73009acd84bb36036ee5e2869112a6c
    - name: mcuboot
      revision: 70bfbd21cdf5f6d1402bc8d0031e197222ed2ec0
      path: bootloader/mcuboot
    - name: mcumgr
      revision: 480cb48e42703e49595a697bb2410a1fcd105f5e
      path: modules/lib/mcumgr
    - name: segger
      path: modules/debug/segger
      revision: 3a52ab222133193802d3c3b4d21730b9b1f1d2f6
    - name: tinycbor
      path: modules/lib/tinycbor
      revision: 40daca97b478989884bffb5226e9ab73ca54b8c4
    - name: tinycrypt
      path: modules/crypto/tinycrypt
      revision: 3e9a49d2672ec01435ffbf0d788db6d95ef28de0
    - name: zephyr
      west-commands: scripts/west-commands.yml
      revision: v2.7.4
  self:
    path: app
```

## drivers/sensor/bma421/Kconfig
```kconfig
# BMA421 Three Axis Accelerometer configuration options

# Copyright (c) 2016 Intel Corporation
# SPDX-License-Identifier: Apache-2.0

menuconfig BMA421
	bool "BMA421 Three Axis Accelerometer Family"
	depends on I2C
	help
	  Enable driver for BMA421 I2C-based triaxial accelerometer sensor
	  family.

if BMA421

choice
	prompt "Trigger mode"
	default BMA421_TRIGGER_GLOBAL_THREAD
	help
	  Specify the type of triggering to be used by the driver.

config BMA421_TRIGGER_NONE
	bool "No trigger"

config BMA421_TRIGGER_GLOBAL_THREAD
	bool "Use global thread"
	depends on GPIO
	select BMA421_TRIGGER

config BMA421_TRIGGER_OWN_THREAD
	bool "Use own thread"
	depends on GPIO
	select BMA421_TRIGGER

endchoice

config BMA421_TRIGGER
	bool

config BMA421_THREAD_PRIORITY
	int "Thread priority"
	depends on BMA421_TRIGGER_OWN_THREAD
	default 10
	help
	  Priority of thread used by the driver to handle interrupts.

config BMA421_THREAD_STACK_SIZE
	int "Thread stack size"
	depends on BMA421_TRIGGER_OWN_THREAD
	default 1024
	help
	  Stack size of thread used by the driver to handle interrupts.

config BMA421_ACC_PERF_MODE
	bool "Performance Mode or Averaging mode"

choice
	prompt "Acceleration measurement range"
	default BMA421_ACC_RANGE_2G
	help
	  Measurement range for acceleration values.

config BMA421_ACC_RANGE_2G
	bool "+/-2g"

config BMA421_ACC_RANGE_4G
	bool "+/-4g"

config BMA421_ACC_RANGE_8G
	bool "+/-8g"

config BMA421_ACC_RANGE_16G
	bool "+/-16g"

endchoice

choice
	prompt "Acceleration data filter bandwidth"
	default BMA421_ACC_ODR_50HZ
	help
	  Bandwidth of filtered acceleration data.
	  When perf mode disabled, ODR must be set to min 50Hz for most features
	  and min 200Hz for double feature

config BMA421_ACC_ODR_0_78HZ
	bool "0.781Hz"

config BMA421_ACC_ODR_1_56HZ
	bool "1.563HZ"

config BMA421_ACC_ODR_3_12HZ
	bool "3.125Hz"

config BMA421_ACC_ODR_6_25HZ
	bool "6.25Hz"

config BMA421_ACC_ODR_12_5HZ
	bool "12.5Hz"

config BMA421_ACC_ODR_25HZ
	bool "25.0Hz"

config BMA421_ACC_ODR_50HZ
	bool "50Hz"

config BMA421_ACC_ODR_100HZ
	bool "100Hz"

config BMA421_ACC_ODR_200HZ
	bool "200Hz"

config BMA421_ACC_ODR_400HZ
	bool "400Hz"

config BMA421_ACC_ODR_800HZ
	bool "800Hz"

config BMA421_ACC_ODR_1600HZ
	bool "1600Hz"

config BMA421_PMU_ODR_UNFILTR
	bool "unfiltered"

endchoice

choice
	prompt "Bandwidth parameter"
	default BMA421_ACC_BWP_NORM_AVG4
	help
	  "Determine filter config (Perf mode) and averaging for undersampling mode"

config BMA421_ACC_BWP_OSR4_AVG1
	bool "Perf. mode => OSR4 Mode / Avg mode => No averaging"

config BMA421_ACC_BWP_OSR2_AVG2
	bool "Perf. mode => OSR2 Mode / Avg mode => Average 2 samples"

config BMA421_ACC_BWP_NORM_AVG4
	bool "Perf. mode => Normal Mode / Avg mode => Average 4 samples"

config BMA421_ACC_BWP_CIC_AVG8
	bool "Perf. mode => Reserved / Avg mode => Average 8 samples"

config BMA421_ACC_BWP_RES_AVG16
	bool "Perf. mode => Reserved / Avg mode => Average 16 samples"

config BMA421_ACC_BWP_RES_AVG32
	bool "Perf. mode => Reserved / Avg mode => Average 32 samples"

config BMA421_ACC_BWP_RES_AVG64
	bool "Perf. mode => Reserved / Avg mode => Average 64 samples"

config BMA421_ACC_BWP_RES_AVG128
	bool "Perf. mode => Reserved / Avg mode => Average 128 samples"

endchoice

endif # BMA421
```

## west.yml
```yaml
# The west manifest file for the Pinetime.
#
# The per-installation west configuration file specifies the location of this
# manifest file. The "path" option in the [manifest] section of .west/config
# defines the folder that contains west.yml. The path is relative to the folder
# that contains .west.
#
# You can create your own manifest files and put them in any
# repository you want, to create your own custom Pinetime installation.
# For example, you could create a manifest file in your own
# out-of-tree application directory, which would pull the pinetime repository
# in as an ordinary project.
#
# You can pass your manifest repositories to west init when creating a
# new pinetime installation. See the west documentation for more
# information.

manifest:
  defaults:
    remote: pinetime

  remotes:
    - name: pinetime
      url-base: https://github.com/zephyrproject-rtos

  # The list of external projects for the Pinetime.
  #
  projects:
    - name: cmsis
      path: modules/hal/cmsis
      revision: 542b2296e6d515b265e25c6b7208e8fea3014f90
    - name: hal_nordic
      path: modules/hal/nordic
      revision: e1168a2f3290f5ca17ec0c47efbf6c601c60108a
    - name: lvgl
      path: modules/lib/gui/lvgl
      revision: 74fc2e753a997bd71cefa34dd9c56dcb954b42e2
    - name: segger
      path: modules/debug/segger
      revision: 6fcf61606d6012d2c44129edc033f59331e268bc
    - name: tinycrypt
      path: modules/crypto/tinycrypt
      revision: 3e9a49d2672ec01435ffbf0d788db6d95ef28de0
    - name: zephyr
      west-commands: scripts/west-commands.yml
      revision: 0b1ef3f6bcea2041170a412001698537361dcbbb
  self:
    path: pinetime
```
